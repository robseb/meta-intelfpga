## emulation/defconfig/arria10_emulation_defconfig
```kconfig
# Configuration for Arria 10 SoC FPGA Emulation
CONFIG_ARM=y
CONFIG_ARCH_SOCFPGA=y
CONFIG_SOCFPGA_ARRIA10=y

# Basic system settings
CONFIG_SYSVIPC=y
CONFIG_POSIX_MQUEUE=y
CONFIG_HIGH_RES_TIMERS=y
CONFIG_MODULES=y
CONFIG_MODULE_UNLOAD=y

# CPU settings
CONFIG_SMP=y
CONFIG_ARM_THUMB=y
CONFIG_VMSPLIT_2G=y
CONFIG_AEABI=y
CONFIG_HIGHMEM=y
CONFIG_VFP=y
CONFIG_NEON=y

# Virtualization support
CONFIG_KVM_GUEST=y
CONFIG_VIRTIO=y
CONFIG_VIRTIO_MENU=y
CONFIG_VIRTIO_PCI=y
CONFIG_VIRTIO_MMIO=y
CONFIG_VIRTIO_MMIO_CMDLINE_DEVICES=y
CONFIG_BLK_MQ_VIRTIO=y

# Block device support
CONFIG_BLK_DEV_SD=y
CONFIG_ATA=y
CONFIG_SATA_AHCI=y
CONFIG_ATA_SFF=y
CONFIG_ATA_BMDMA=y

# File systems
CONFIG_EXT4_FS=y
CONFIG_EXT4_FS_POSIX_ACL=y
CONFIG_EXT4_FS_SECURITY=y
CONFIG_VFAT_FS=y
CONFIG_9P_FS=y
CONFIG_NET_9P_VIRTIO=y

# Serial port support
CONFIG_SERIAL_8250=y
CONFIG_SERIAL_8250_CONSOLE=y
CONFIG_SERIAL_8250_NR_UARTS=4
CONFIG_SERIAL_8250_EXTENDED=y
CONFIG_SERIAL_8250_MANY_PORTS=y
CONFIG_SERIAL_8250_SHARE_IRQ=y
CONFIG_SERIAL_OF_PLATFORM=y

# Console
CONFIG_TTY=y
CONFIG_VIRTIO_CONSOLE=y

# Networking
CONFIG_NET_CORE=y
CONFIG_VIRTIO_NET=y
CONFIG_ETHERNET=y
CONFIG_NETDEVICES=y
CONFIG_NET_VENDOR_INTEL=y

# USB support
CONFIG_USB=y
CONFIG_USB_XHCI_HCD=y
CONFIG_USB_EHCI_HCD=y
CONFIG_USB_STORAGE=y
CONFIG_USB_SUPPORT=y
CONFIG_USB_HID=y

# Real Time Clock
CONFIG_RTC_CLASS=y
CONFIG_RTC_DRV_PL031=y

# Random number generation
CONFIG_HW_RANDOM=y
CONFIG_HW_RANDOM_VIRTIO=y

# Misc
CONFIG_PRINTK=y
CONFIG_DEBUG_FS=y
CONFIG_MAGIC_SYSRQ=y
CONFIG_EARLY_PRINTK=y
```

## recipes-kernel/linux-altera-lts/files/agilex5_defconfig
```kconfig
# ARM64 defconfig for Intel Agilex5 SoC FPGA Hardware
# ARM DynamIQ with Cortex-A76/A55 configuration

CONFIG_64BIT=y
CONFIG_ARM64=y
CONFIG_MMU=y
CONFIG_SMP=y

# ARM DynamIQ support
CONFIG_ARCH_SUPPORTS_BIG_ENDIAN=y
CONFIG_CPU_LITTLE_ENDIAN=y
CONFIG_ARM64_4K_PAGES=y
CONFIG_ARM64_VA_BITS_39=y
CONFIG_ARM64_VA_BITS=39
CONFIG_ARM64_PA_BITS_48=y
CONFIG_ARM64_PA_BITS=48
CONFIG_NR_CPUS=8
CONFIG_HOTPLUG_CPU=y
CONFIG_SCHED_MC=y
CONFIG_SCHED_SMT=y
CONFIG_ARM64_DMA_USE_IOMMU=y

# CPU idle and power management
CONFIG_CPU_IDLE=y
CONFIG_ARM_CPUIDLE=y
CONFIG_CPU_FREQ=y
CONFIG_CPUFREQ_DT=y
CONFIG_ARM_BIG_LITTLE_CPUFREQ=y

# ARM Architecture support
CONFIG_ARM_AMBA=y
CONFIG_ARM_ARCH_TIMER=y
CONFIG_ARM_ARCH_TIMER_EVTSTREAM=y
CONFIG_ARM_GIC=y
CONFIG_ARM_GIC_V3=y
CONFIG_ARM_PSCI=y

# Serial console support (DW APB UART)
CONFIG_SERIAL_8250=y
CONFIG_SERIAL_8250_CONSOLE=y
CONFIG_SERIAL_8250_DW=y
CONFIG_SERIAL_CORE=y
CONFIG_SERIAL_CORE_CONSOLE=y
CONFIG_SERIAL_EARLYCON=y
CONFIG_EARLY_PRINTK=y

# Console support
CONFIG_TTY=y
CONFIG_VT=y
CONFIG_VT_CONSOLE=y
CONFIG_VT_HW_CONSOLE_BINDING=y
CONFIG_UNIX98_PTYS=y

# Network support
CONFIG_NET=y
CONFIG_PACKET=y
CONFIG_UNIX=y
CONFIG_INET=y
CONFIG_IP_MULTICAST=y
CONFIG_IP_ADVANCED_ROUTER=y
CONFIG_IP_PNP=y
CONFIG_IP_PNP_DHCP=y
CONFIG_IP_PNP_BOOTP=y
CONFIG_IPV6=y

# Ethernet drivers
CONFIG_NETDEVICES=y
CONFIG_ETHERNET=y
CONFIG_STMMAC_ETH=y
CONFIG_STMMAC_PLATFORM=y
CONFIG_DWMAC_SOCFPGA=y

# MMC/SD card support
CONFIG_MMC=y
CONFIG_MMC_DW=y
CONFIG_MMC_DW_SOCFPGA=y

# I2C support
CONFIG_I2C=y
CONFIG_I2C_DESIGNWARE_CORE=y
CONFIG_I2C_DESIGNWARE_PLATFORM=y

# SPI support
CONFIG_SPI=y
CONFIG_SPI_DW=y
CONFIG_SPI_DW_MMIO=y

# GPIO support
CONFIG_GPIOLIB=y
CONFIG_GPIO_DWAPB=y
CONFIG_GPIO_SYSFS=y

# Watchdog support
CONFIG_WATCHDOG=y
CONFIG_DW_WATCHDOG=y

# USB support
CONFIG_USB=y
CONFIG_USB_XHCI_HCD=y
CONFIG_USB_XHCI_PLATFORM=y
CONFIG_USB_EHCI_HCD=y
CONFIG_USB_OHCI_HCD=y
CONFIG_USB_STORAGE=y

# File systems
CONFIG_EXT2_FS=y
CONFIG_EXT3_FS=y
CONFIG_EXT4_FS=y
CONFIG_VFAT_FS=y
CONFIG_FAT_FS=y
CONFIG_TMPFS=y
CONFIG_TMPFS_POSIX_ACL=y

# Device Tree support
CONFIG_OF=y
CONFIG_OF_FLATTREE=y
CONFIG_OF_EARLY_FLATTREE=y
CONFIG_OF_ADDRESS=y
CONFIG_OF_IRQ=y
CONFIG_OF_RESERVED_MEM=y

# Debug support
CONFIG_PRINTK=y
CONFIG_PRINTK_TIME=y
CONFIG_DEBUG_KERNEL=y
CONFIG_DEBUG_INFO=y

# Kernel features
CONFIG_CGROUPS=y
CONFIG_NAMESPACES=y
CONFIG_SYSFS=y
CONFIG_PROC_FS=y
CONFIG_DEVTMPFS=y
CONFIG_DEVTMPFS_MOUNT=y

# ARM DynamIQ performance monitoring
CONFIG_ARM_PMU=y
CONFIG_HW_PERF_EVENTS=y

# Default hostname
CONFIG_DEFAULT_HOSTNAME="agilex5"
```

## recipes-kernel/linux-altera-lts/files/agilex5_qemu_virt_defconfig
```kconfig
# Configuration for Intel Agilex 5 SoC FPGA - QEMU Emulator
# Based on agilex5_defconfig with QEMU-specific optimizations
# ARM64 DynamIQ Big.LITTLE Configuration

#
# ARM64 Base Configuration
#
CONFIG_ARM64=y
CONFIG_ARM64_PAGE_SHIFT=12
CONFIG_ARM64_4K_PAGES=y
CONFIG_ARM64_VA_BITS_48=y
CONFIG_ARM64_PA_BITS=48

#
# CPU Configuration - Cortex-A76/A55 DynamIQ
#
CONFIG_SMP=y
CONFIG_NR_CPUS=8
CONFIG_ARM64_DMA_USE_IOMMU=y
CONFIG_ARM_CPUIDLE=y
CONFIG_ARM_PSCI=y

#
# ARM DynamIQ Big.LITTLE Support
#
CONFIG_BIG_LITTLE=y
CONFIG_ARM64_CRYPTO=y
CONFIG_CRYPTO_SHA1_ARM64_CE=y
CONFIG_CRYPTO_SHA2_ARM64_CE=y
CONFIG_CRYPTO_AES_ARM64_CE_CCM=y
CONFIG_CRYPTO_AES_ARM64_CE_BLK=y
CONFIG_CRYPTO_CHACHA20_NEON=y

#
# CPU Frequency Scaling
#
CONFIG_CPU_FREQ=y
CONFIG_CPU_FREQ_DEFAULT_GOV_SCHEDUTIL=y
CONFIG_CPU_FREQ_GOV_PERFORMANCE=y
CONFIG_CPU_FREQ_GOV_POWERSAVE=y
CONFIG_CPU_FREQ_GOV_USERSPACE=y
CONFIG_CPU_FREQ_GOV_ONDEMAND=y
CONFIG_CPU_FREQ_GOV_CONSERVATIVE=y
CONFIG_CPUFREQ_DT=y

#
# ARM DynamIQ Scheduler Support
#
CONFIG_SCHED_MC=y
CONFIG_SCHED_BOOK=y
CONFIG_SCHED_SMT=y
CONFIG_FAIR_GROUP_SCHED=y
CONFIG_CFS_BANDWIDTH=y

#
# Power Management
#
CONFIG_PM=y
CONFIG_PM_SLEEP=y
CONFIG_SUSPEND=y
CONFIG_PM_RUNTIME=y
CONFIG_PM_DEVFREQ=y
CONFIG_DEVFREQ_GOV_SIMPLE_ONDEMAND=y
CONFIG_DEVFREQ_GOV_PERFORMANCE=y
CONFIG_DEVFREQ_GOV_POWERSAVE=y
CONFIG_DEVFREQ_GOV_USERSPACE=y

#
# Platform Support
#
CONFIG_ARCH_VEXPRESS=y
CONFIG_ARCH_SOCFPGA=y

#
# QEMU Emulator Specific
#
CONFIG_VIRTIO=y
CONFIG_VIRTIO_PCI=y
CONFIG_VIRTIO_MMIO=y
CONFIG_VIRTIO_MMIO_CMDLINE_DEVICES=y
CONFIG_VIRTIO_BLK=y
CONFIG_VIRTIO_NET=y
CONFIG_VIRTIO_CONSOLE=y
CONFIG_VIRTIO_BALLOON=y
CONFIG_VIRTIO_INPUT=y

#
# Device Drivers
#
CONFIG_NET=y
CONFIG_PACKET=y
CONFIG_UNIX=y
CONFIG_INET=y
CONFIG_IPV6=y
CONFIG_NETFILTER=y

#
# Block Device Support
#
CONFIG_BLK_DEV=y
CONFIG_BLK_DEV_LOOP=y
CONFIG_BLK_DEV_RAM=y
CONFIG_BLK_DEV_RAM_COUNT=16
CONFIG_BLK_DEV_RAM_SIZE=65536

#
# Filesystem Support
#
CONFIG_EXT4_FS=y
CONFIG_EXT4_FS_POSIX_ACL=y
CONFIG_EXT4_FS_SECURITY=y
CONFIG_PROC_FS=y
CONFIG_SYSFS=y
CONFIG_TMPFS=y
CONFIG_TMPFS_POSIX_ACL=y
CONFIG_DEVTMPFS=y
CONFIG_DEVTMPFS_MOUNT=y

#
# Console and Serial Support
#
CONFIG_TTY=y
CONFIG_SERIAL_8250=y
CONFIG_SERIAL_8250_CONSOLE=y
CONFIG_SERIAL_AMBA_PL011=y
CONFIG_SERIAL_AMBA_PL011_CONSOLE=y
CONFIG_HW_CONSOLE=y
CONFIG_VT=y
CONFIG_VT_CONSOLE=y

#
# Module Support
#
CONFIG_MODULES=y
CONFIG_MODULE_UNLOAD=y
CONFIG_MODVERSIONS=y
CONFIG_MODULE_SRCVERSION_ALL=y

#
# Debugging and Development
#
CONFIG_DEBUG_KERNEL=y
CONFIG_DEBUG_INFO=y
CONFIG_DEBUG_INFO_DWARF4=y
CONFIG_GDB_SCRIPTS=y
CONFIG_ENABLE_WARN_DEPRECATED=y
CONFIG_FRAME_WARN=1024

#
# Security
#
CONFIG_SECURITY=y
CONFIG_SECURITY_NETWORK=y
CONFIG_SECURITYFS=y
CONFIG_LSM="yama,loadpin,safesetid,integrity,selinux,smack,tomoyo,apparmor"

#
# Intel Agilex 5 SoC FPGA Specific
#
CONFIG_ALTERA_FPGA2SDR=y
CONFIG_FPGA=y
CONFIG_FPGA_MGR_ALTERA_PS_SPI=y
CONFIG_FPGA_MGR_ALTERA_CVP=y
CONFIG_FPGA_BRIDGE=y
CONFIG_ALTERA_FREEZE_BRIDGE=y
CONFIG_FPGA_REGION=y
CONFIG_OF_FPGA_REGION=y

#
# Clock and Reset Support
#
CONFIG_COMMON_CLK=y
CONFIG_COMMON_CLK_FIXED_RATE=y
CONFIG_COMMON_CLK_FIXED_FACTOR=y
CONFIG_CLK_SOCFPGA=y
CONFIG_RESET_CONTROLLER=y
CONFIG_RESET_SOCFPGA=y

#
# GPIO Support
#
CONFIG_GPIOLIB=y
CONFIG_GPIO_SYSFS=y
CONFIG_GPIO_GENERIC=y
CONFIG_GPIO_DWAPB=y
CONFIG_GPIO_ALTERA=y

#
# I2C Support
#
CONFIG_I2C=y
CONFIG_I2C_CHARDEV=y
CONFIG_I2C_DESIGNWARE_CORE=y
CONFIG_I2C_DESIGNWARE_PLATFORM=y

#
# SPI Support  
#
CONFIG_SPI=y
CONFIG_SPI_MASTER=y
CONFIG_SPI_DESIGNWARE=y
CONFIG_SPI_DW_MMIO=y

#
# USB Support
#
CONFIG_USB_SUPPORT=y
CONFIG_USB=y
CONFIG_USB_EHCI_HCD=y
CONFIG_USB_OHCI_HCD=y

#
# MMC/SD Support
#
CONFIG_MMC=y
CONFIG_MMC_BLOCK=y
CONFIG_MMC_DW=y
CONFIG_MMC_DW_SOCFPGA=y

#
# RTC Support  
#
CONFIG_RTC_CLASS=y
CONFIG_RTC_DRV_PL031=y

#
# Watchdog Support
#
CONFIG_WATCHDOG=y
CONFIG_DW_WATCHDOG=y

#
# DMA Support
#
CONFIG_DMADEVICES=y
CONFIG_DW_DMAC_CORE=y
CONFIG_DW_DMAC=y

#
# Enable Device Tree
#
CONFIG_OF=y
CONFIG_OF_FLATTREE=y
CONFIG_OF_EARLY_FLATTREE=y
CONFIG_OF_DYNAMIC=y
CONFIG_OF_ADDRESS=y
CONFIG_OF_IRQ=y
CONFIG_OF_NET=y
CONFIG_OF_GPIO=y

# Enable initramfs/initrd support  
CONFIG_BLK_DEV_INITRD=y
CONFIG_INITRAMFS_SOURCE=""
CONFIG_RD_GZIP=y
CONFIG_RD_BZIP2=y
CONFIG_RD_LZMA=y
CONFIG_RD_XZ=y
CONFIG_RD_LZO=y
CONFIG_RD_LZ4=y
```

## recipes-kernel/linux/files/agilex3_qemu_virt_defconfig
```kconfig
# ARM64 QEMU virt machine defconfig for Agilex 3 emulator
# Based on qemuarm64 and customized for QEMU virt machine

CONFIG_64BIT=y
CONFIG_ARCH_MMAP_RND_BITS_MAX=33
CONFIG_ARCH_MMAP_RND_BITS_MIN=18
CONFIG_ARCH_MMAP_RND_COMPAT_BITS_MAX=16
CONFIG_ARCH_MMAP_RND_COMPAT_BITS_MIN=11

# ARM64 Architecture
CONFIG_ARM64=y
CONFIG_ARM_AMBA=y
CONFIG_ARM_ARCH_TIMER=y
CONFIG_ARM_ARCH_TIMER_EVTSTREAM=y
CONFIG_ARM_CPUIDLE=y
CONFIG_ARM_GIC=y
CONFIG_ARM_GIC_V2M=y
CONFIG_ARM_GIC_V3=y
CONFIG_ARM_PSCI=y

# CPU Features
CONFIG_ARM64_4K_PAGES=y
CONFIG_ARM64_VA_BITS_39=y
CONFIG_ARM64_VA_BITS=39
CONFIG_ARM64_PAGE_SHIFT=12
CONFIG_ARCH_PROC_KCORE_TEXT=y

# QEMU virt machine
CONFIG_ARCH_VIRT=y
CONFIG_ARM64_DMA_USE_IOMMU=y

# Serial console support (PL011)
CONFIG_SERIAL_AMBA_PL011=y
CONFIG_SERIAL_AMBA_PL011_CONSOLE=y
CONFIG_SERIAL_CORE=y
CONFIG_SERIAL_CORE_CONSOLE=y
CONFIG_SERIAL_EARLYCON=y
CONFIG_EARLY_PRINTK=y

# Console support
CONFIG_TTY=y
CONFIG_VT=y
CONFIG_VT_CONSOLE=y
CONFIG_VT_HW_CONSOLE_BINDING=y
CONFIG_UNIX98_PTYS=y

# Virtio support (essential for QEMU virt)
CONFIG_VIRTIO=y
CONFIG_VIRTIO_PCI=y
CONFIG_VIRTIO_PCI_LIB=y
CONFIG_VIRTIO_BALLOON=y
CONFIG_VIRTIO_BLK=y
CONFIG_VIRTIO_NET=y
CONFIG_VIRTIO_CONSOLE=y
CONFIG_VIRTIO_MMIO=y
CONFIG_VIRTIO_MMIO_CMDLINE_DEVICES=y

# Block device support
CONFIG_BLK_DEV=y
CONFIG_BLK_DEV_LOOP=y
CONFIG_BLOCK=y

# Filesystem support
CONFIG_EXT2_FS=y
CONFIG_EXT3_FS=y
CONFIG_EXT4_FS=y
CONFIG_EXT4_USE_FOR_EXT2=y

# Network support
CONFIG_NET=y
CONFIG_PACKET=y
CONFIG_INET=y
CONFIG_IP_PNP=y
CONFIG_IP_PNP_DHCP=y
CONFIG_IP_PNP_BOOTP=y
CONFIG_IP_PNP_RARP=y

# QEMU RTC support
CONFIG_RTC_CLASS=y
CONFIG_RTC_DRV_PL031=y

# PCI support
CONFIG_PCI=y
CONFIG_PCI_HOST_GENERIC=y

# Timer support
CONFIG_GENERIC_CLOCKEVENTS=y
CONFIG_GENERIC_TIME=y

# Power management
CONFIG_SUSPEND=y
CONFIG_HIBERNATION=y
CONFIG_PM=y

# Debugging
CONFIG_PRINTK=y
CONFIG_PRINTK_TIME=y
CONFIG_DEBUG_KERNEL=y
CONFIG_DEBUG_INFO=y

# Additional features
CONFIG_MODULES=y
CONFIG_MODULE_UNLOAD=y
CONFIG_SMP=y
CONFIG_PREEMPT=y
CONFIG_HZ=250
```

## recipes-kernel/linux/files/agilex5_defconfig
```kconfig
# Agilex5 default kernel configuration with DynamIQ support
# This is the base defconfig for Agilex5 hardware with ARM DynamIQ

# Architecture and CPU
CONFIG_ARM64=y
CONFIG_64BIT=y
CONFIG_ARM64_4K_PAGES=y
CONFIG_ARM64_VA_BITS_48=y
CONFIG_ARM64_PA_BITS_48=y

# SMP and DynamIQ features
CONFIG_SMP=y
CONFIG_NR_CPUS=8
CONFIG_SCHED_MC=y
CONFIG_SCHED_SMT=y
CONFIG_ARM64_LSE_ATOMICS=y

# Platform support
CONFIG_ARCH_SOCFPGA=y
CONFIG_ARCH_STRATIX10=y
CONFIG_ARCH_AGILEX=y

# Memory management
CONFIG_ARM64_DMA_USE_COHERENT_HELPERS=y
CONFIG_ZONE_DMA=y
CONFIG_ZONE_DMA32=y
CONFIG_TRANSPARENT_HUGEPAGE=y
CONFIG_COMPACTION=y

# Platform devices
CONFIG_ARM_AMBA=y
CONFIG_ARM_GIC=y
CONFIG_ARM_GIC_V3=y
CONFIG_ARM_GIC_V3_ITS=y
CONFIG_ARM_PSCI=y

# Timers
CONFIG_ARM_ARCH_TIMER=y
CONFIG_ARM_ARCH_TIMER_EVTSTREAM=y

# Power management and DynamIQ CPU scaling
CONFIG_PM=y
CONFIG_PM_SLEEP=y
CONFIG_PM_RUNTIME=y
CONFIG_CPU_FREQ=y
CONFIG_CPU_FREQ_STAT=y
CONFIG_CPU_FREQ_GOVERNOR_PERFORMANCE=y
CONFIG_CPU_FREQ_GOVERNOR_ONDEMAND=y
CONFIG_CPU_FREQ_GOVERNOR_SCHEDUTIL=y
CONFIG_CPUFREQ_DT=y
CONFIG_ARM_SCPI_CPUFREQ=y

# CPU idle
CONFIG_CPU_IDLE=y
CONFIG_ARM_CPUIDLE=y

# Thermal management for big.LITTLE
CONFIG_THERMAL=y
CONFIG_CPU_THERMAL=y
CONFIG_THERMAL_GOV_STEP_WISE=y

# NUMA for multi-cluster
CONFIG_NUMA=y

# Performance monitoring
CONFIG_ARM_PMU=y
CONFIG_ARM_SPE_PMU=y

# Networking
CONFIG_NET=y
CONFIG_INET=y
CONFIG_IPV6=y

# Device drivers
CONFIG_BLOCK=y
CONFIG_BLK_DEV_SD=y
CONFIG_ATA=y
CONFIG_ATA_GENERIC=y
CONFIG_ATA_PIIX=y
CONFIG_SATA_AHCI=y
CONFIG_SATA_AHCI_PLATFORM=y

# Serial console
CONFIG_SERIAL_8250=y
CONFIG_SERIAL_8250_CONSOLE=y
CONFIG_SERIAL_8250_DW=y

# MMC/SD support
CONFIG_MMC=y
CONFIG_MMC_SDHCI=y
CONFIG_MMC_SDHCI_PLTFM=y
CONFIG_MMC_DW=y

# I2C support
CONFIG_I2C=y
CONFIG_I2C_DESIGNWARE_CORE=y
CONFIG_I2C_DESIGNWARE_PLATFORM=y

# SPI support
CONFIG_SPI=y
CONFIG_SPI_DESIGNWARE=y

# GPIO support
CONFIG_GPIOLIB=y
CONFIG_GPIO_DWAPB=y

# Ethernet
CONFIG_NETDEVICES=y
CONFIG_NET_ETHERNET=y
CONFIG_STMMAC_ETH=y
CONFIG_STMMAC_PLATFORM=y

# USB support
CONFIG_USB=y
CONFIG_USB_EHCI_HCD=y
CONFIG_USB_OHCI_HCD=y
CONFIG_USB_STORAGE=y

# File systems
CONFIG_EXT4_FS=y
CONFIG_VFAT_FS=y
CONFIG_TMPFS=y
CONFIG_TMPFS_POSIX_ACL=y

# Kernel features
CONFIG_PRINTK_TIME=y
CONFIG_LOG_BUF_SHIFT=14
CONFIG_IKCONFIG=y
CONFIG_IKCONFIG_PROC=y

# Module support
CONFIG_MODULES=y
CONFIG_MODULE_UNLOAD=y
CONFIG_MODVERSIONS=y
```
