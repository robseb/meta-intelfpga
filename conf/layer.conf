## conf/layer.conf
```bitbake
# We have a conf and classes directory, add to BBPATH
BBPATH .= ":${LAYERDIR}"

# We have recipes-* directories, add to BBFILES
BBFILES += "${LAYERDIR}/recipes-*/*/*.bb \
            ${LAYERDIR}/recipes-*/*/*.bbappend"

BBFILE_COLLECTIONS += "meta-intelfpga"
BBFILE_PATTERN_meta-intelfpga = "^${LAYERDIR}/"
BBFILE_PRIORITY_meta-intelfpga = "6"

LAYERDEPENDS_meta-intelfpga = "core"
LAYERSERIES_COMPAT_meta-intelfpga = "warrior zeus dunfell gatesgarth "
```

## conf/machine/agilex.conf
```bitbake
#
## Robin Sebastian (git@robseb.de)
#

#@TYPE: Machine
#@NAME: Altera Agilex
#@DESCRIPTION: Layer for the Intel PSG Agilex

DESCRIPTON = "BSP Machine configuration for the Intel PSG (ALTERA) Agilex SoC-FPGA"


KBUILD_DEFCONFIG ?= "agilex_minimal_defconfig"

require conf/machine/include/socfpga_armv8a.inc


SERIAL_CONSOLES ?= "115200;ttyS0"

IMAGE_FSTYPES += "tar.gz"
```

## conf/machine/arria5.conf
```bitbake
#
##  Robin Sebastian @ rsyocto GmbH & Co. KG (git@robseb.de)
#

#@TYPE: Machine
#@NAME: arria5
#@DESCRIPTION: Machine configuration for the Arria V SoC" 

require conf/machine/include/socfpga.inc

DESCRIPTON = "BSP Machine configuration for the Intel (ALTERA) Arria V SX SoC-FPGA"

KMACHINE = "arria5"

SERIAL_CONSOLES ?= "115200;ttyS0"

IMAGE_FSTYPES +="tar.gz"
```

## conf/machine/include/socfpga_armv8a.inc
```bitbake
require conf/machine/include/arm/arch-armv8a.inc

KERNEL_PROVIDER ?= "linux-altera"
PREFERRED_PROVIDER_virtual/kernel ?= "${KERNEL_PROVIDER}"
KERNEL_IMAGETYPE = "Image"
MACHINE_EXTRA_RRECOMMENDS += "kernel-modules"

KBUILD_DEFCONFIG ?= "defconfig"

IMAGE_FSTYPES ?= "tar.gz"
```

## conf/machine/stratix10.conf
```bitbake
#
## Robin Sebastian (git@robseb.de)
#

#@TYPE: Machine
#@NAME: Altera Stratix10
#@DESCRIPTION: Layer for the Altera Stratix10

DESCRIPTON = "BSP Machine configuration for the Intel PSG (ALTERA) Strarix 10  SoC-FPGA"

require conf/machine/include/socfpga_armv8a.inc

SERIAL_CONSOLES ?= "115200;ttyS0"

IMAGE_FSTYPES += "tar.gz"
```
